## Kconfig
```kconfig
mainmenu "auroraOS Configuration"

choice
    prompt "Target Hardware Board"
    default BOARD_LM3S6965_QB
    help
      Select the hardware target board for auroraOS.

config BOARD_LM3S6965_QB
    bool "TI LM3S6965-QB (QEMU Cortex-M3)"

config BOARD_MIBAND8
    bool "Xiaomi Mi Band 8 (Ambiq Apollo3 Cortex-M4F)"

config BOARD_QEMU_RV32_VIRT
    bool "QEMU RISC-V 32 Virt (RV32IMAC)"

config BOARD_NUCLEO_L031K6
    bool "ST Nucleo-L031K6 (Cortex-M0+)"

config BOARD_QEMU_AARCH64_VIRT
    bool "QEMU AArch64 Virt (Cortex-A53 / ARMv8-A)"

endchoice

config BOARD
    string
    default "lm3s6965-qb" if BOARD_LM3S6965_QB
    default "miband8" if BOARD_MIBAND8
    default "qemu_rv32_virt" if BOARD_QEMU_RV32_VIRT
    default "nucleo_l031k6" if BOARD_NUCLEO_L031K6
    default "qemu_aarch64_virt" if BOARD_QEMU_AARCH64_VIRT

menu "System Core Configuration"

config SCHEDULER
    bool "Enable Task Scheduler"
    default y
    help
      Enable the preemptive priority-based task scheduler.

config MAX_TASKS
    int "Maximum number of tasks"
    default 8 if BOARD_MIBAND8
    default 16
    help
      The maximum number of tasks the scheduler can manage.

config TICK_RATE_HZ
    int "System Tick Rate (Hz)"
    default 1000
    help
      The frequency of the system tick interrupt in Hz.

config NO_DYNAMIC_ALLOCATION
    bool "Disable Dynamic Memory Allocation"
    default y
    help
      If enabled, all new/malloc calls will trigger a panic. Enforces static memory allocation.

endmenu

menu "File Systems"

config VFS
    bool "Virtual File System (VFS)"
    default y
    help
      Enable the Virtual File System layer.

config FS_RAMFS
    bool "RAM File System (RamFS)"
    depends on VFS
    default y
    help
      Enable the RamFS.

config FS_PROCFS
    bool "Process File System (ProcFS)"
    depends on VFS
    default y
    help
      Enable the ProcFS for system information.

endmenu

menu "Device Drivers"

config DEVICE_UART
    bool "UART Driver"
    default y
    help
      Enable UART character device driver.

config TIMER_MANAGER
    bool "Software Timer Manager"
    default y
    help
      Enable the software timer daemon.

config WORK_QUEUE
    bool "Work Queue"
    default y
    help
      Enable the background work queue for deferring ISR work.

endmenu

menu "Networking"

config NETWORKING
    bool "Networking Support"
    default n if BOARD_MIBAND8
    default y
    help
      Enable networking subsystem.

config NET_LWIP
    bool "LwIP Stack"
    depends on NETWORKING
    default y
    help
      Enable the LwIP network stack.

config NET_DEFAULT_IP
    string "Default IP Address"
    depends on NET_LWIP
    default "10.0.2.15"

config NET_DEFAULT_MAC
    string "Default MAC Address"
    depends on NET_LWIP
    default "00:11:22:33:44:55"

config OTA_DEV_MODE
	bool "OTA Development Mode (MOCK Ed25519 + Placeholder Keys)"
	default y if BOARD_LM3S6965_QB || BOARD_QEMU_RV32_VIRT
	default n
	help
	  Enable mock Ed25519 signatures and placeholder root public keys
	  for OTA firmware verification.  Automatically enabled for QEMU
	  builds; must be explicitly disabled for real hardware.

	  WARNING: ALL firmware images will pass signature verification
	  when this option is enabled.  Any attacker who can deliver an OTA
	  update will achieve arbitrary code execution.

	  This option MUST be disabled for any build that ships to users
	  or connects to untrusted networks.

choice
	prompt "Stealth Identity Preset"
	depends on NET_LWIP
	default STEALTH_HP_LASERJET
	help
	  Select what kind of device auroraOS should impersonate on the LAN.
	  This controls MAC OUI (vendor prefix), DHCP hostname, and DHCP
	  Option 55 parameter request list fingerprint.

config STEALTH_NONE
	bool "No spoofing (use real MAC from board config)"
	help
	  Disables all stealth features. Uses the MAC and hostname configured
	  via NET_DEFAULT_MAC / board.h.

config STEALTH_APPLE_IPAD
	bool "Apple iPad (iPad-of-Staff)"
	help
	  Impersonate an Apple iPad. MAC OUI: 10:DD:B1 (Apple Inc.),
	  Hostname: iPad-of-Staff, DHCP fingerprint: iOS 15.x.

config STEALTH_APPLE_IPHONE
	bool "Apple iPhone (iPhone-15)"
	help
	  Impersonate an Apple iPhone. MAC OUI: 10:DD:B1 (Apple Inc.),
	  Hostname: iPhone-15, DHCP fingerprint: iOS 15.x.

config STEALTH_APPLE_MACBOOK
	bool "Apple MacBook (MacBook-Pro)"
	help
	  Impersonate an Apple MacBook. MAC OUI: 10:DD:B1 (Apple Inc.),
	  Hostname: MacBook-Pro, DHCP fingerprint: iOS 15.x.

config STEALTH_HP_LASERJET
	bool "HP LaserJet Printer (HP-LaserJet-M402dn)"
	help
	  Impersonate an HP LaserJet office printer. Most innocuous device
	  on a corporate LAN. MAC OUI: 00:26:55 (HP), Hostname:
	  HP-LaserJet-M402dn, DHCP fingerprint: HP Printer firmware.

config STEALTH_HP_OFFICEJET
	bool "HP OfficeJet Pro (HP-OfficeJet-Pro9010)"
	help
	  Impersonate an HP OfficeJet all-in-one. MAC OUI: 00:26:55 (HP),
	  Hostname: HP-OfficeJet-Pro9010, DHCP fingerprint: HP Printer.

config STEALTH_SAMSUNG_GALAXY
	bool "Samsung Galaxy S24"
	help
	  Impersonate a Samsung Android phone. MAC OUI: 8C:F5:A3 (Samsung),
	  Hostname: Galaxy-S24, DHCP fingerprint: default lwIP.

endchoice

config STEALTH_DHCP_FINGERPRINT
	int "DHCP Option 55 Fingerprint"
	depends on NET_LWIP
	default 0 if STEALTH_NONE || STEALTH_SAMSUNG_GALAXY
	default 1 if STEALTH_APPLE_IPAD || STEALTH_APPLE_IPHONE || STEALTH_APPLE_MACBOOK
	default 3 if STEALTH_HP_LASERJET || STEALTH_HP_OFFICEJET
	help
	  0 = lwIP default (Subnet/Router/Broadcast/DNS)
	  1 = iOS 15.x (10 parameters)
	  2 = Windows 10/11 (12 parameters)
	  3 = HP Printer firmware (6 parameters)

config BLE_ENABLED
	bool "Bluetooth Low Energy (BLE)"
	depends on NET_LWIP
	default y if ENABLE_BLE_5_2
	default n
	help
	  Enable Bluetooth Low Energy 5.x subsystem including GAP
	  advertising, GATT services, and BLE security framework.

choice
	prompt "BLE Stealth Identity Preset"
	depends on BLE_ENABLED
	default STEALTH_BLE_AIRTAG
	help
	  Select what kind of BLE peripheral auroraOS should impersonate
	  in its advertising packets. This controls GAP Flags (stripping
	  discoverable bits) and Manufacturer Specific Data (iBeacon
	  format with Apple company ID 0x004C).

	  In stealth mode, the device is invisible in system Bluetooth
	  settings but reachable via direct-connection by MAC. BLE IDS
	  and Apple Find My network classify it as a legitimate Apple
	  tracker/peripheral.

config STEALTH_BLE_NONE
	bool "No spoofing (normal advertising)"
	help
	  Disables BLE stealth. Standard GAP Discoverable advertising
	  with device name \"Aurora_MiBand8\".

config STEALTH_BLE_AIRTAG
	bool "Apple AirTag"
	help
	  Impersonate an Apple AirTag tracker. Non-discoverable GAP
	  Flags + iBeacon Manufacturer Data (Apple 0x004C).
	  TX Power: -59 dBm.

config STEALTH_BLE_AIRPODS_PRO
	bool "Apple AirPods Pro"
	help
	  Impersonate Apple AirPods Pro. Non-discoverable + iBeacon
	  (AirPods Pro UUID). TX Power: -54 dBm.

config STEALTH_BLE_AIRPODS
	bool "Apple AirPods (Standard)"
	help
	  Impersonate standard Apple AirPods. Non-discoverable +
	  iBeacon (AirPods UUID). TX Power: -55 dBm.

config STEALTH_BLE_APPLE_PENCIL
	bool "Apple Pencil (2nd Gen)"
	help
	  Impersonate Apple Pencil (2nd gen). Non-discoverable +
	  iBeacon (Apple Pencil UUID). TX Power: -62 dBm.

endchoice

endmenu

menu "Secure Boot Configuration"

config SECURE_BOOT_DEV_MODE
	bool "Secure Boot Development Mode (MOCK Public Key)"
	depends on OTA_DEV_MODE
	default y
	help
	  Use a mock public key (0xAA-filled) in the bootloader for firmware
	  verification at boot time.  This option is automatically enabled when
	  OTA Development Mode is active.

	  WARNING: Any firmware with 0xED-filled signature will boot.

endmenu

menu "Watchdog"

config WATCHDOG
    bool "Hardware Watchdog Timer"
    default n if BOARD_NUCLEO_L031K6
    default y
    help
      Enable hardware watchdog timer for system recovery.
      On QEMU platforms without physical WDT, a software timer
      is used instead. Disabled on nucleo_l031k6 (resource-constrained).

config WATCHDOG_TIMEOUT_MS
    int "Watchdog timeout (milliseconds)"
    depends on WATCHDOG
    default 5000
    help
      Timeout before hardware reset. Must be long enough for the
      longest expected task execution plus scheduling overhead.

endmenu

menu "Applications and runtimes"

config LUA_VM
    bool "Lua 5.4.6 Virtual Machine"
    default y if BOARD_MIBAND8
    default n
    help
      Enable the Lua scripting engine.
      WARNING: Lua 5.4.6 requires significant memory. It is highly recommended to disable this on targets with < 128KB SRAM (e.g. LM3S6965) to avoid OOM crashes.

endmenu

source "Kconfig.miband"
```

## Kconfig.miband
```kconfig
if BOARD_MIBAND8

config TARGET_MIBAND
    bool
    default y
    help
      Enable MiBand target adaptations.

# ========================================================
# 1. 架构与 SoC 级配置
# ========================================================
menu "System & Architecture"

config ARCH_CORTEX_M4F
    bool "Ambiq Apollo3 Cortex-M4F Architecture"
    default y
    help
      Enable hardware floating-point unit (FPU) and Cortex-M4F specific context switching.

config SYSTEM_CORE_CLOCK
    int "System Core Clock (Hz)"
    default 96000000
    help
      Apollo3 Blue runs at 96MHz.

endmenu

# ========================================================
# 2. 内核、内存与电源调度机制
# ========================================================
menu "Kernel & Power Management"

config POWER_MANAGER
    bool "5-Level Power State Machine"
    default y
    help
      Enable Active, Dim, Idle, Sleep, and Critical power states.

config WRIST_WAKE_DETECTOR
    bool "Wrist Wake Detection (Z-Axis)"
    depends on POWER_MANAGER && SENSOR_BHI260AP
    default y
    help
      Use accelerometer data to wake the screen when the user raises their wrist.

config FRAME_SCHEDULER_V2
    bool "Dynamic Frame Scheduler (0-30 FPS)"
    default y
    help
      Replaces fixed 30fps scheduler. Pauses UI thread at 0fps during sleep.

endmenu

# ========================================================
# 3. 硬件驱动层
# ========================================================
menu "Hardware Drivers"

config DISPLAY_ST7789
    bool "ST7789 AMOLED Display Driver"
    default y
    help
      Driver for the 1.62-inch 192x490 SPI display.

config GESTURE_RECOGNIZER
    bool "7-State Gesture Engine"
    default y
    help
      Translates raw GT316 touch events into Tap, Swipe, and Long Press gestures.

config SENSOR_GH3026
    bool "GH3026 PPG Heart Rate Sensor"
    default y

config SENSOR_BHI260AP
    bool "BHI260AP 6-Axis Accelerometer (Pedometer)"
    default y

config BUTTON_SIDE
    bool "Support miband8 side button driver"
    default y
    help
      Polling driver for the Mi Band 8 physical side button (GPIO,
      active-low with internal pull-up). Produces EV_KEY events with
      KeyCode::KEY_POWER (short press / long press distinguished by
      value 1=down / 0=up / 2=repeat).

endmenu

# ========================================================
# 4. 网络层 (BLE 替换 lwIP)
# ========================================================
menu "Network & Connectivity"

config BLE_STACK
    bool "BLE 5.2 GATT Server Framework"
    default y
    help
      Replaces Ethernet/lwIP. Includes Device Info, Time, Heart Rate, and Battery services.

endmenu

# ========================================================
# 5. 应用层
# ========================================================
menu "Application Layer"

config WATCH_APP
    bool "Main Watch Face Application"
    default y

config FONT_ENGINE
    bool "Bitmap Font Engine"
    depends on WATCH_APP
    default y
    help
      Renders text and numbers for the watch face.

endmenu

endif
```

## ai/february/Kconfig
```kconfig
# February AI runtime - board / product Kconfig fragment
# Source from the top-level Kconfig:
#   source "ai/february/Kconfig"

menuconfig FEBRUARY
	bool "February AI runtime (cross-device OS service)"
	default y
	help
	  Header-only, zero-heap intent / context / persona / SoftBus service.
	  Disable on ultra-tiny images that only need legacy IntentEngine.

if FEBRUARY

config FEBRUARY_SERVICE
	bool "FebruaryService task loop"
	default y
	help
	  Always-on service: SoftBus drain -> tick -> process_events.

config FEBRUARY_PLANNER
	bool "Fixed-depth Planner (Intent -> Action sequence)"
	default y
	help
	  Compile-time / swappable PlanRule table. Disable to shrink code.

config FEBRUARY_SOFTBUS
	bool "SoftBus facade + codec + transport ops"
	default y
	help
	  Binary Intent frames over platform SoftBus / mock / UART bridge.

config FEBRUARY_PEER_TABLE
	bool "Peer last-seen / open / fail table"
	default y
	depends on FEBRUARY_SOFTBUS
	help
	  Fixed-slot peer state for cross-device diagnostics.

config FEBRUARY_REMOTE_YIELD_TO_LOCAL
	bool "Local intents preempt remote in same run_once"
	default y
	depends on FEBRUARY_SOFTBUS
	help
	  Prefer local IntentDetected over SoftBus remote on the same tick.

config FEBRUARY_PLANNER_MAX_STEPS
	int "Max plan steps per intent"
	range 1 8
	default 4
	depends on FEBRUARY_PLANNER

config FEBRUARY_SOFTBUS_QUEUE_DEPTH
	int "SoftBus RX inbox depth"
	range 2 32
	default 8
	depends on FEBRUARY_SOFTBUS

config FEBRUARY_SOFTBUS_MAX_SESSIONS
	int "Max SoftBus sessions / registered peers"
	range 1 16
	default 4
	depends on FEBRUARY_SOFTBUS

config FEBRUARY_PEER_TABLE_SIZE
	int "Peer table slots"
	range 1 16
	default 4
	depends on FEBRUARY_PEER_TABLE

config FEBRUARY_SERVICE_MAX_EVENTS
	int "Max events drained per run_once"
	range 1 32
	default 8
	depends on FEBRUARY_SERVICE

config FEBRUARY_SOFTBUS_PKG
	string "SoftBus package name"
	default "aurora.february"
	depends on FEBRUARY_SOFTBUS

config FEBRUARY_SOFTBUS_SESSION
	string "SoftBus session name"
	default "february.intent"
	depends on FEBRUARY_SOFTBUS

# ----------------------------------------------------------------
# 记忆子系统（本次新增）
#
# 这三个开关与各自的规模参数此前只存在于 config.hpp 的 `#ifndef` 兜底里，
# Kconfig 完全看不到 —— 意味着宿主机与固件各自用一套互不知情的默认值，
# 且在 Flash / BSS 受限的板子上没有任何可调的削减杠杆。补齐后，
# ai/february/kconfig_glue.hpp 负责把 CONFIG_FEBRUARY_* 翻译成
# config.hpp 认的 FEBRUARY_* 宏。
# ----------------------------------------------------------------

config FEBRUARY_WORLD_MODEL
	bool "World model (device/room state tracking)"
	default y
	help
	  跟踪设备与房间状态，供跨设备意图路由使用。
	  关闭可省去 world_model.hpp 的静态表与相关推理代码。

config FEBRUARY_WORLD_MODEL_SIZE
	int "World model slots"
	range 1 16
	default 4
	depends on FEBRUARY_WORLD_MODEL

config FEBRUARY_WORKING_MEMORY
	bool "Working memory (sliding context window)"
	default y
	help
	  滑动时间窗内的上下文槽位。槽位数与窗口长度直接决定 RAM 占用。

config FEBRUARY_WORKING_MEMORY_SLOTS
	int "Working memory slots"
	range 4 128
	default 64
	depends on FEBRUARY_WORKING_MEMORY

config FEBRUARY_WORKING_MEMORY_WINDOW_MS
	int "Working memory window (milliseconds)"
	range 10000 900000
	default 300000
	depends on FEBRUARY_WORKING_MEMORY

config FEBRUARY_EPISODIC_MEMORY
	bool "Episodic memory (habit slots)"
	default y
	help
	  习惯画像槽位。在 SRAM 紧张的板子（如 MiBand 8）上是最先该关的候选。

config FEBRUARY_EPISODIC_MAX_HABITS
	int "Episodic memory habit slots"
	range 2 32
	default 16
	depends on FEBRUARY_EPISODIC_MEMORY

endif # FEBRUARY
```
